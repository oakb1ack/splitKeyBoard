## config/boards/shields/splitkeyboard/Kconfig.defconfig
```kconfig
if SHIELD_SPLITKEYBOARD_LEFT

config ZMK_KEYBOARD_NAME
    default "Split Keyboard"

config ZMK_SPLIT_ROLE_CENTRAL
    default y

endif

if SHIELD_SPLITKEYBOARD_LEFT || SHIELD_SPLITKEYBOARD_RIGHT

config ZMK_SPLIT
    default y

endif
```
